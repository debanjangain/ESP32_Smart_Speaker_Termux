## esp32-firmware/Kconfig.projbuild
```kconfig
menu "ESP32 Music Project Configuration"

config WIFI_SSID
    string "Wi-Fi SSID"
    default "moto g45 5G"

config WIFI_PASS
    string "Wi-Fi Password"
    default "7278346049"

config SERVER_URI
    string "Backend WebSocket server URI"
    default "ws://YOUR_SERVER_IP:8765"

config WAKE_TASK_STACK
    int "Wake word task stack size"
    default 4096

config WAKE_TASK_PRIORITY
    int "Wake word task priority"
    default 5

config AUDIO_TASK_STACK
    int "Audio task stack size"
    default 4096

config AUDIO_TASK_PRIORITY
    int "Audio task priority"
    default 6

config STREAM_TASK_STACK
    int "Streaming task stack size"
    default 4096

config STREAM_TASK_PRIORITY
    int "Streaming task priority"
    default 4

config WS_RECONNECT_MS
    int "WebSocket reconnect delay (ms)"
    default 5000

endmenu
```
